## CMakeLists.txt
```
cmake_minimum_required(VERSION 3.20.0)

find_package(Zephyr REQUIRED HINTS $ENV{ZEPHYR_BASE})
project(workshop)

target_include_directories(app PRIVATE include)
target_sources(app PRIVATE
    src/main.c
    src/controller_ipc.c
    src/sensor_driver.c
    src/board_io_buzzer.c
    src/board_io_button.c
    src/fusion.c
    src/comms_codec.c
    src/comms_transport.c
    src/comms_tx.c
    src/comms_rx.c
)

# fw_version reported in the boot-time HELLO line (communication.spec.md);
# controller_id is a Kconfig string instead (see app/Kconfig) so each
# flashed board can be told apart without a rebuild.
target_compile_definitions(app PRIVATE APP_FW_VERSION="0.1.0")
```

## Kconfig
```
source "Kconfig.zephyr"

menu "Communication (serial protocol) options"

config CONTROLLER_ID
	string "Controller identifier reported in the HELLO line"
	default "ctrl-A"
	help
	  Sent as <controller_id> in "HELLO <controller_id> <fw_version>" at
	  boot (see specs/communication.spec.md). Set a distinct value per
	  flashed board (e.g. ctrl-A / ctrl-B) via a board-specific
	  prj.conf/overlay or -DCONFIG_CONTROLLER_ID=\"ctrl-B\" so a host
	  talking to two boards can tell them apart.

endmenu
```

## prj.conf
```kconfig
# sensor-driver component (app/src/sensor_driver.c)
CONFIG_I2C=y
CONFIG_SENSOR=y

# board-io component (app/src/board_io_buzzer.c, app/src/board_io_button.c)
CONFIG_PWM=y
CONFIG_GPIO=y

# --- Communication component (specs/communication.spec.md) ---
# Serial protocol vs. logging: move Zephyr logging to RTT so USART1 (the
# board's console UART) carries only the HELLO/BTN/GESTURE/AXIS/BUZZ/
# PONG/RESET protocol, with no interleaved printk/log output. See
# docs/task-distribution.md "Serial protocol vs. logging".
CONFIG_LOG=y
CONFIG_LOG_BACKEND_RTT=y
CONFIG_USE_SEGGER_RTT=y
CONFIG_LOG_BACKEND_UART=n

# USART1 stays enabled (CONFIG_SERIAL/console Kconfig on) but the protocol
# talks to it directly via the interrupt-driven UART driver API rather than
# the console subsystem -- see comms_transport.c.
CONFIG_SERIAL=y
CONFIG_UART_INTERRUPT_DRIVEN=y
CONFIG_CONSOLE=y
CONFIG_UART_CONSOLE=y

# %f in comms_codec.c's snprintf-based line encoder (GESTURE/AXIS confidence
# and value fields) needs picolibc's float printf support enabled.
CONFIG_PICOLIBC_IO_FLOAT=y
CONFIG_CBPRINTF_FP_SUPPORT=y

# RESET command (comms_rx.c) calls sys_reboot().
CONFIG_REBOOT=y

# comms_tx.c services button_evt_q/controller_evt_q via k_poll().
CONFIG_POLL=y
```

## src/main.c
```c
/*
 * Supervisor: wires up the one component that doesn't self-start.
 *
 * The sensor driver, fusion, and communication threads all start
 * automatically via K_THREAD_DEFINE. Board I/O's buzzer/button primitives
 * are the exception (board_io.h) and must be explicitly initialized once
 * at boot before anything calls buzzer_request() or expects button events.
 * See specs/supervisor.spec.md.
 */

#include <zephyr/kernel.h>
#include <zephyr/logging/log.h>

#include "board_io.h"

LOG_MODULE_REGISTER(main, CONFIG_LOG_DEFAULT_LEVEL);

int main(void)
{
	int ret;

	printk("Game controller firmware booting (%s)\n", CONFIG_BOARD_TARGET);

	ret = board_io_buzzer_init();
	if (ret < 0) {
		LOG_ERR("board_io_buzzer_init failed: %d (buzzer will not work)", ret);
	}

	ret = board_io_button_init();
	if (ret < 0) {
		LOG_ERR("board_io_button_init failed: %d (button events will not work)", ret);
	}

	LOG_INF("Startup complete (sensor driver / fusion / communication threads "
		"are already running via K_THREAD_DEFINE)");

	return 0;
}
```

## include/board_io.h
```c
#pragma once

/*
 * Board I/O: buzzer + button primitives.
 *
 * buzzer_request() is declared in controller_ipc.h (the frozen shared
 * contract) since communication calls it directly; it is implemented in
 * board_io_buzzer.c. This header only carries board-I/O-internal helpers
 * that other components don't need.
 */

#include "controller_ipc.h"

/**
 * @brief Initialize the board I/O buzzer PWM output.
 *
 * Must be called once at startup (e.g. from main()) before the first
 * buzzer_request() call. Safe to call again; re-initialization is a no-op
 * if already done.
 *
 * @return 0 on success, negative errno on failure.
 */
int board_io_buzzer_init(void);

/**
 * @brief Initialize the board I/O button (gpio-keys sw0) input + debounce.
 *
 * Configures the interrupt and debounce work; confirmed press/release
 * transitions are pushed onto button_evt_q from controller_ipc.h.
 *
 * @return 0 on success, negative errno on failure.
 */
int board_io_button_init(void);
```

## include/comms_codec.h
```c
#ifndef COMMS_CODEC_H_
#define COMMS_CODEC_H_

/*
 * Pure line-formatting/parsing for the board<->host ASCII serial protocol
 * described in intent.md / specs/communication.spec.md.
 *
 * Deliberately hardware- and Zephyr-independent (only <stdint.h>/<stdbool.h>/
 * <stddef.h>) so it can be built and unit-tested with a plain host compiler,
 * with no UART/kernel dependency. The actual I/O ("transport") lives in
 * comms_tx.c / comms_rx.c.
 */

#include <stdint.h>
#include <stdbool.h>
#include <stddef.h>

#ifdef __cplusplus
extern "C" {
#endif

/* Big enough for any line this protocol emits/accepts, plus '\n'+'\0'. */
#define COMMS_CODEC_MAX_LINE 96

/* ---------------- Encode: board -> host ---------------- */

/*
 * Each comms_encode_* function renders one line WITHOUT a trailing newline
 * into buf (NUL-terminated). Returns the number of characters that would
 * have been written (as snprintf does), or a negative value on a bad
 * argument (e.g. NULL buf/name). Callers should treat a return >= buf_len
 * as truncation.
 */
int comms_encode_hello(char *buf, size_t buf_len, const char *controller_id,
			const char *fw_version);
int comms_encode_btn(char *buf, size_t buf_len, uint8_t id, bool pressed, int64_t t_ms);
int comms_encode_gesture(char *buf, size_t buf_len, const char *name, float confidence,
			  int64_t t_ms);
int comms_encode_axis(char *buf, size_t buf_len, const char *name, float value, int64_t t_ms);
int comms_encode_pong(char *buf, size_t buf_len, int64_t t_ms);

/* ---------------- Decode: host -> board ---------------- */

enum comms_cmd_type {
	COMMS_CMD_BUZZ,
	COMMS_CMD_PING,
	COMMS_CMD_RESET,
	COMMS_CMD_UNKNOWN, /* malformed or unrecognized: log + ignore, never fatal */
};

struct comms_cmd {
	enum comms_cmd_type type;
	union {
		struct {
			uint32_t freq_hz;
			uint32_t duration_ms;
		} buzz;
		struct {
			int64_t t_ms;
		} ping;
	};
};

/*
 * Parses one line (a NUL-terminated string; a trailing '\n' and/or '\r' is
 * tolerated and stripped, not required). Always fills *out and returns 0,
 * EXCEPT when line or out is NULL, in which case it returns -1 and leaves
 * *out untouched. A recognized keyword with a malformed body (wrong
 * argument count/type) or an unrecognized keyword both yield
 * out->type == COMMS_CMD_UNKNOWN (return value is still 0) -- callers
 * decide how to log that, but must never treat it as fatal.
 */
int comms_decode_line(const char *line, struct comms_cmd *out);

#ifdef __cplusplus
}
#endif

#endif /* COMMS_CODEC_H_ */
```

## include/comms_transport.h
```c
#ifndef COMMS_TRANSPORT_H_
#define COMMS_TRANSPORT_H_

/*
 * The UART I/O ("transport") half of the board<->host protocol link.
 * Talks to the protocol UART (chosen zephyr,console -- USART1 on the demo
 * board) directly via the interrupt-driven UART driver API, bypassing the
 * console/logging subsystem entirely, so nothing but protocol lines ever
 * hits the wire. See specs/communication.spec.md.
 *
 * Line framing/parsing itself lives in comms_codec.h/.c, which knows
 * nothing about the UART; this module knows nothing about the protocol
 * grammar.
 */

#include <stddef.h>

#ifdef __cplusplus
extern "C" {
#endif

/*
 * Binds the protocol UART device and starts interrupt-driven RX. Must be
 * called once (from comms_tx or wherever the app wires threads up) before
 * comms_transport_send_line()/recv_line(). Returns 0 on success, a negative
 * errno if the device isn't ready.
 */
int comms_transport_init(void);

/*
 * Blocks the calling thread until comms_transport_init() has completed
 * (successfully or not). Lets comms_rx start its RX loop only once the
 * device is bound, without caring which of comms_tx/comms_rx's
 * auto-started threads happens to run first.
 */
void comms_transport_wait_ready(void);

/*
 * Queues one already-formatted protocol line (no trailing '\n' -- this
 * function appends it) for interrupt-driven transmission. Only meant to be
 * called from a single producer thread (comms_tx); safe to call
 * concurrently with comms_transport_recv_line() from another thread.
 */
void comms_transport_send_line(const char *line);

/*
 * Blocks the calling thread until one complete line has arrived from the
 * UART, and copies it (NUL-terminated, CR/LF already stripped) into buf
 * (truncated to buf_len - 1 bytes if necessary). Only meant to be called
 * from a single consumer thread (comms_rx).
 */
void comms_transport_recv_line(char *buf, size_t buf_len);

#ifdef __cplusplus
}
#endif

#endif /* COMMS_TRANSPORT_H_ */
```

## include/controller_ipc.h
```c
#pragma once
#include <zephyr/kernel.h>
#include <stdint.h>
#include <stdbool.h>

/* sensor driver -> fusion */
struct imu_sample {
    int64_t t_ms;
    float ax, ay, az;   /* g */
    float gx, gy, gz;   /* deg/s */
};

/* board I/O -> communication (buttons are already discrete/debounced) */
struct button_event {
    uint8_t id;
    bool pressed;
    int64_t t_ms;
};

/* fusion -> communication */
enum controller_evt_type { EVT_GESTURE, EVT_AXIS };
enum gesture_id {
    GESTURE_SWING_UP, GESTURE_SWING_DOWN,
    GESTURE_SWING_LEFT, GESTURE_SWING_RIGHT,
    GESTURE_SHAKE, GESTURE_PUNCH,
};

struct controller_event {
    enum controller_evt_type type;
    int64_t t_ms;
    union {
        struct { enum gesture_id id; float confidence; } gesture;
        struct { const char *name; float value; } axis; /* e.g. "tilt_x" */
    };
};

/* communication -> board I/O (host BUZZ command) */
void buzzer_request(uint32_t freq_hz, uint32_t duration_ms);

extern struct k_msgq imu_sample_q;      /* sensor driver produces, fusion consumes */
extern struct k_msgq button_evt_q;      /* board I/O produces, communication consumes */
extern struct k_msgq controller_evt_q;  /* fusion produces, communication consumes */
```

## include/fusion.h
```c
#pragma once

/*
 * Fusion / gesture-recognition module.
 *
 * Consumes struct imu_sample from imu_sample_q and produces
 * struct controller_event onto controller_evt_q (both frozen in
 * controller_ipc.h):
 *
 *   - EVT_GESTURE: one of GESTURE_SWING_UP/DOWN/LEFT/RIGHT, GESTURE_SHAKE,
 *     GESTURE_PUNCH, one event per distinct motion (debounced/cooldown'd,
 *     not a flood of repeats).
 *   - EVT_AXIS "tilt_x": a low-pass-filtered roll value in [-1.0, 1.0],
 *     published at a throttled rate (see FUSION_TILT_PUBLISH_MS).
 *
 * The processing thread is started automatically at boot via
 * K_THREAD_DEFINE in fusion.c; there is no explicit init/start API for
 * main.c to call. This header is a placeholder for any future public
 * surface (e.g. if a supervisor ever needs to query fusion state), and
 * documents the module's inputs/outputs.
 *
 * Tunable thresholds/timings live in fusion_tuning.h, not here.
 */
```

## include/fusion_tuning.h
```c
#pragma once

/*
 * Tunable constants for the fusion/gesture module (app/src/fusion.c).
 *
 * Centralized here so thresholds, filter coefficients, and timing windows
 * can be retuned against real motion data without touching the detection
 * logic itself. Expect these to need iteration once real hardware/mounting
 * is available (see fusion-gesture spec + final report open questions).
 *
 * All accel-deviation constants are in units of g, relative to the
 * assumed FUSION_GRAVITY_G resting baseline.
 *
 * --- Axis convention ---
 *   ax: forward(+) / back(-)          -> GESTURE_PUNCH   (still a heuristic
 *                                        guess, unconfirmed on hardware)
 *   ay: right(+)   / left(-)          -> GESTURE_SWING_RIGHT / _LEFT
 *                                        (still a heuristic guess, unconfirmed)
 *   az: DOWN(+)    / UP(-) (about the resting ~1g baseline)
 *                                     -> GESTURE_SWING_DOWN / _UP
 * The az mapping was confirmed INVERTED from the original guess by testing
 * on real hardware (a physical swing up peaks negative on dz, not
 * positive) and fixed in fusion.c's classifier accordingly. ax/ay are
 * unchanged from the original guess and still need the same real-hardware
 * check -- this mapping depends on how the board is physically held/
 * mounted, so don't assume they're right just because az turned out to
 * need flipping.
 */

/* Deviation from the gravity baseline (g) that starts a motion episode.
 * Raised from an initial 0.35g: that let casual handling/light taps enter
 * motion tracking at all, which combined with FUSION_MIN_MOTION_MS below
 * was still producing gesture events for a tap. */
#define FUSION_MOTION_ENTER_G          0.50f

/* Deviation from baseline (g) below which the board is considered at rest
 * again. Lower than the enter threshold on purpose (hysteresis) so a
 * motion episode doesn't flicker closed on a single noisy dip mid-motion.
 */
#define FUSION_MOTION_EXIT_G           0.15f

/* Consecutive "at rest" samples required (in addition to being below the
 * exit threshold) before a motion episode is closed out and classified.
 */
#define FUSION_REST_CONFIRM_SAMPLES    3

/* Minimum duration (ms) a motion episode must last before it's eligible to
 * be classified as a gesture at all. A tap/knock on the enclosure is a
 * sharp, near-instantaneous transient (typically settles back under
 * FUSION_MOTION_EXIT_G within a couple of samples); a deliberate swing/
 * shake/punch takes a real hand motion's worth of time. An episode that
 * closes out faster than this is discarded as noise (back to IDLE, no
 * event, no cooldown) rather than classified. */
#define FUSION_MIN_MOTION_MS           100

/* Hard cap on how long a single motion episode can run before it is
 * force-classified. Guards against a sensor that never settles back down.
 */
#define FUSION_MAX_MOTION_MS           800

/* Per-axis deviation magnitude (g) above which a sample counts toward
 * sign-reversal tracking (used to distinguish SHAKE from a directional
 * swing/punch). Raised alongside FUSION_MOTION_ENTER_G so reversal
 * tracking isn't more sensitive than motion entry itself. */
#define FUSION_REVERSAL_SIGN_G         0.30f

/* Minimum number of dominant-axis sign reversals within one motion episode
 * to classify it as GESTURE_SHAKE instead of a single directional gesture.
 * Raised from 3: a vigorous but single-direction swing/punch can pick up
 * a reversal or two from hand jitter alone, so 3 was firing on those too
 * often. */
#define FUSION_SHAKE_MIN_REVERSALS     4

/* Cooldown after emitting a gesture event before a new motion episode can
 * start. Keeps one physical motion from producing a flood of events. */
#define FUSION_GESTURE_COOLDOWN_MS     300

/* Peak deviation magnitude (g) that saturates reported gesture confidence
 * to 1.0. */
#define FUSION_CONFIDENCE_SATURATE_G   1.2f

/* Assumed resting accelerometer reading (g) on the "up" axis; used as the
 * baseline that motion deviation is measured against. */
#define FUSION_GRAVITY_G               1.0f

/* --- Continuous tilt_x (roll) axis --- */

/* Low-pass filter coefficient (exponential moving average), in (0,1].
 * Higher = less smoothing / more responsive. */
#define FUSION_TILT_LPF_ALPHA          0.15f

/* Publish period for the tilt_x EVT_AXIS event; throttled so the
 * downstream serial link isn't flooded (spec: ~20 Hz). */
#define FUSION_TILT_PUBLISH_MS         50

/* Roll angle (deg) that normalizes to a full-scale +-1.0 axis value. */
#define FUSION_TILT_MAX_DEG            45.0f
```

## include/sensor_driver.h
```c
#pragma once

/*
 * Sensor driver module: samples the onboard LSM6DSO16IS IMU (accel + gyro)
 * at ~100 Hz and publishes each reading as a `struct imu_sample` (see
 * controller_ipc.h) onto `imu_sample_q`.
 *
 * The sampling thread is started automatically via K_THREAD_DEFINE in
 * sensor_driver.c; there is nothing to call from main() or elsewhere.
 * This header exists as an extension point (e.g. exposing tunables) if
 * other components need to reference this module later.
 */
```

## src/board_io_button.c
```c
/*
 * Board I/O: button (gpio-keys / sw0) driver.
 *
 * GPIO interrupt + ~30ms re-check debounce, pushing a confirmed-transition
 * struct button_event onto button_evt_q (controller_ipc.h) for the
 * communication component to forward as `BTN <id> <DOWN|UP> <t_ms>`.
 * See specs/board-io.spec.md.
 *
 * Button pin: boards/demo/demo.dts wires sw0 to the onboard Nucleo B1
 * user button, gpioc pin 13, GPIO_ACTIVE_HIGH (confirmed against ST's
 * upstream nucleo_u385rg_q Zephyr board port + UM3062 — see demo.dts).
 */

#include <zephyr/kernel.h>
#include <zephyr/device.h>
#include <zephyr/devicetree.h>
#include <zephyr/drivers/gpio.h>
#include <zephyr/logging/log.h>

#include "board_io.h"

LOG_MODULE_REGISTER(board_io_button, LOG_LEVEL_INF);

#define BUTTON_ID 0U
#define BUTTON_DEBOUNCE_MS 30U

static const struct gpio_dt_spec button = GPIO_DT_SPEC_GET(DT_ALIAS(sw0), gpios);

static struct gpio_callback button_cb_data;
static struct k_work_delayable button_debounce_work;
static int button_last_state = -1; /* -1 = unknown, forces first report */

static void button_push_event(bool pressed)
{
	struct button_event evt = {
		.id = BUTTON_ID,
		.pressed = pressed,
		.t_ms = k_uptime_get(),
	};

	/* Never block the workqueue thread on a full queue — drop and log
	 * instead. The communication thread is expected to drain this
	 * promptly; a full queue means something downstream is stuck.
	 */
	if (k_msgq_put(&button_evt_q, &evt, K_NO_WAIT) != 0) {
		LOG_WRN("button_evt_q full, dropping event");
	}
}

static void button_debounce_work_handler(struct k_work *work)
{
	int state = gpio_pin_get_dt(&button);

	ARG_UNUSED(work);

	if (state < 0) {
		LOG_ERR("gpio_pin_get_dt failed: %d", state);
		return;
	}

	if (state != button_last_state) {
		button_last_state = state;
		button_push_event(state != 0);
	}
}

static void button_gpio_isr(const struct device *dev, struct gpio_callback *cb,
			     uint32_t pins)
{
	ARG_UNUSED(dev);
	ARG_UNUSED(cb);
	ARG_UNUSED(pins);

	/* Re-check the pin ~30ms after the edge rather than trusting it
	 * immediately — standard mechanical-switch debounce. Rescheduling
	 * on every edge naturally rides out bounce trains.
	 */
	k_work_reschedule(&button_debounce_work, K_MSEC(BUTTON_DEBOUNCE_MS));
}

int board_io_button_init(void)
{
	int ret;

	if (!device_is_ready(button.port)) {
		LOG_ERR("button GPIO port not ready");
		return -ENODEV;
	}

	ret = gpio_pin_configure_dt(&button, GPIO_INPUT);
	if (ret < 0) {
		LOG_ERR("failed to configure button pin: %d", ret);
		return ret;
	}

	k_work_init_delayable(&button_debounce_work, button_debounce_work_handler);

	ret = gpio_pin_interrupt_configure_dt(&button, GPIO_INT_EDGE_BOTH);
	if (ret < 0) {
		LOG_ERR("failed to configure button interrupt: %d", ret);
		return ret;
	}

	gpio_init_callback(&button_cb_data, button_gpio_isr, BIT(button.pin));
	ret = gpio_add_callback(button.port, &button_cb_data);
	if (ret < 0) {
		LOG_ERR("failed to add button callback: %d", ret);
		return ret;
	}

	/* Prime last-known state so we don't spuriously report a transition
	 * for the initial level (and so debounce logic has a baseline).
	 */
	button_last_state = gpio_pin_get_dt(&button);

	return 0;
}
```

## src/board_io_buzzer.c
```c
/*
 * Board I/O: buzzer (PWM) driver.
 *
 * Implements buzzer_request() from controller_ipc.h — the shared entry
 * point the communication component calls on an incoming host `BUZZ`
 * line. See specs/board-io.spec.md.
 */

#include <zephyr/kernel.h>
#include <zephyr/device.h>
#include <zephyr/drivers/pwm.h>
#include <zephyr/logging/log.h>

#include "board_io.h"

LOG_MODULE_REGISTER(board_io_buzzer, LOG_LEVEL_INF);

/* aliases { buzzer = &pwm1; } in boards/demo/demo.dts; pwm1 is the child
 * "pwm" node of &timers3 (TIM3), pinctrl'd to tim3_ch2_pc7 (Arduino D8).
 */
#define BUZZER_PWM_NODE DT_ALIAS(buzzer)
#define BUZZER_PWM_CHANNEL 2U /* TIM3 CH2 */

static const struct device *buzzer_pwm_dev = DEVICE_DT_GET(BUZZER_PWM_NODE);

static struct k_timer buzzer_off_timer;
static struct k_work buzzer_off_work;

/* Runs on the system workqueue thread (not the timer-expiry ISR context),
 * so it is always safe to call into the PWM driver here.
 */
static void buzzer_off_work_handler(struct k_work *work)
{
	ARG_UNUSED(work);

	(void)pwm_set(buzzer_pwm_dev, BUZZER_PWM_CHANNEL, 0, 0, PWM_POLARITY_NORMAL);
}

/* k_timer expiry function: runs in ISR/system-timeout context. Keep this
 * minimal and non-blocking — just hand off to the workqueue.
 */
static void buzzer_off_timer_handler(struct k_timer *timer)
{
	ARG_UNUSED(timer);

	k_work_submit(&buzzer_off_work);
}

int board_io_buzzer_init(void)
{
	if (!device_is_ready(buzzer_pwm_dev)) {
		LOG_ERR("buzzer PWM device not ready");
		return -ENODEV;
	}

	k_work_init(&buzzer_off_work, buzzer_off_work_handler);
	k_timer_init(&buzzer_off_timer, buzzer_off_timer_handler, NULL);

	return 0;
}

/*
 * void buzzer_request(uint32_t freq_hz, uint32_t duration_ms) — declared in
 * controller_ipc.h (frozen shared contract), implemented here.
 *
 * Non-blocking: sets the PWM period/pulse for freq_hz at ~50% duty, arms a
 * k_timer for duration_ms, and returns immediately. Safe to call from any
 * thread context (e.g. the communication thread on an incoming BUZZ line).
 */
void buzzer_request(uint32_t freq_hz, uint32_t duration_ms)
{
	uint32_t period_ns;
	uint32_t pulse_ns;
	int ret;

	if (!device_is_ready(buzzer_pwm_dev)) {
		return;
	}

	if (freq_hz == 0U || duration_ms == 0U) {
		/* Treat as "stop" rather than guessing a frequency. */
		k_timer_stop(&buzzer_off_timer);
		k_work_submit(&buzzer_off_work);
		return;
	}

	period_ns = (uint32_t)(NSEC_PER_SEC / freq_hz);
	pulse_ns = period_ns / 2U; /* ~50% duty */

	ret = pwm_set(buzzer_pwm_dev, BUZZER_PWM_CHANNEL, period_ns, pulse_ns,
		      PWM_POLARITY_NORMAL);
	if (ret < 0) {
		LOG_ERR("pwm_set failed: %d", ret);
		return;
	}

	/* Restarting an already-running timer is fine — it just reschedules
	 * the off-transition, so back-to-back BUZZ requests behave sanely.
	 */
	k_timer_start(&buzzer_off_timer, K_MSEC(duration_ms), K_NO_WAIT);
}
```

## src/comms_codec.c
```c
#include "comms_codec.h"

#include <stdio.h>
#include <string.h>

int comms_encode_hello(char *buf, size_t buf_len, const char *controller_id,
			const char *fw_version)
{
	if (!buf || !controller_id || !fw_version) {
		return -1;
	}
	return snprintf(buf, buf_len, "HELLO %s %s", controller_id, fw_version);
}

int comms_encode_btn(char *buf, size_t buf_len, uint8_t id, bool pressed, int64_t t_ms)
{
	if (!buf) {
		return -1;
	}
	return snprintf(buf, buf_len, "BTN %u %s %lld", (unsigned int)id,
			 pressed ? "DOWN" : "UP", (long long)t_ms);
}

int comms_encode_gesture(char *buf, size_t buf_len, const char *name, float confidence,
			  int64_t t_ms)
{
	if (!buf || !name) {
		return -1;
	}
	return snprintf(buf, buf_len, "GESTURE %s %.3f %lld", name, (double)confidence,
			 (long long)t_ms);
}

int comms_encode_axis(char *buf, size_t buf_len, const char *name, float value, int64_t t_ms)
{
	if (!buf || !name) {
		return -1;
	}
	return snprintf(buf, buf_len, "AXIS %s %.3f %lld", name, (double)value,
			 (long long)t_ms);
}

int comms_encode_pong(char *buf, size_t buf_len, int64_t t_ms)
{
	if (!buf) {
		return -1;
	}
	return snprintf(buf, buf_len, "PONG %lld", (long long)t_ms);
}

int comms_decode_line(const char *line, struct comms_cmd *out)
{
	if (!line || !out) {
		return -1;
	}

	char work[COMMS_CODEC_MAX_LINE];
	size_t len = 0;

	while (line[len] != '\0' && len < sizeof(work) - 1) {
		work[len] = line[len];
		len++;
	}
	work[len] = '\0';

	/* Strip trailing CR/LF (frames may arrive as "...\r\n" or "...\n"). */
	while (len > 0 && (work[len - 1] == '\n' || work[len - 1] == '\r')) {
		work[--len] = '\0';
	}

	out->type = COMMS_CMD_UNKNOWN;

	char keyword[16];
	int consumed = 0;

	if (sscanf(work, "%15s%n", keyword, &consumed) != 1) {
		/* Empty/whitespace-only line: unknown, not an error. */
		return 0;
	}

	const char *rest = work + consumed;

	if (strcmp(keyword, "BUZZ") == 0) {
		unsigned long freq_hz = 0;
		unsigned long duration_ms = 0;

		if (sscanf(rest, "%lu %lu", &freq_hz, &duration_ms) == 2) {
			out->type = COMMS_CMD_BUZZ;
			out->buzz.freq_hz = (uint32_t)freq_hz;
			out->buzz.duration_ms = (uint32_t)duration_ms;
		}
	} else if (strcmp(keyword, "PING") == 0) {
		long long t_ms = 0;

		if (sscanf(rest, "%lld", &t_ms) == 1) {
			out->type = COMMS_CMD_PING;
			out->ping.t_ms = (int64_t)t_ms;
		}
	} else if (strcmp(keyword, "RESET") == 0) {
		out->type = COMMS_CMD_RESET;
	}
	/* Anything else (unrecognized keyword, or a recognized keyword with a
	 * malformed body) leaves out->type == COMMS_CMD_UNKNOWN. The caller
	 * logs and ignores it; this function never fails on bad input, only
	 * on NULL arguments.
	 */

	return 0;
}
```

## src/comms_rx.c
```c
/*
 * RX side of the board<->host protocol link: parses incoming lines and
 * dispatches BUZZ/PING/RESET. Malformed or unrecognized lines are logged
 * (via RTT) and ignored -- must never crash or wedge the link. See
 * specs/communication.spec.md.
 */

#include "comms_transport.h"
#include "comms_codec.h"
#include "controller_ipc.h"

#include <zephyr/kernel.h>
#include <zephyr/logging/log.h>
#include <zephyr/sys/reboot.h>

LOG_MODULE_REGISTER(comms_rx, CONFIG_LOG_DEFAULT_LEVEL);

static void handle_line(const char *line)
{
	struct comms_cmd cmd;

	if (comms_decode_line(line, &cmd) != 0) {
		/* Only NULL args cause this, which can't happen with a valid
		 * local buffer, but stay defensive rather than assume.
		 */
		LOG_WRN("comms_decode_line rejected input");
		return;
	}

	switch (cmd.type) {
	case COMMS_CMD_BUZZ:
		/* board-io's implementation (feature/board-io branch); only
		 * the declaration in controller_ipc.h is available here.
		 */
		buzzer_request(cmd.buzz.freq_hz, cmd.buzz.duration_ms);
		break;

	case COMMS_CMD_PING: {
		char buf[COMMS_CODEC_MAX_LINE];

		comms_encode_pong(buf, sizeof(buf), cmd.ping.t_ms);
		comms_transport_send_line(buf);
		break;
	}

	case COMMS_CMD_RESET:
		LOG_WRN("RESET command received; rebooting");
		sys_reboot(SYS_REBOOT_WARM);
		break; /* unreachable */

	case COMMS_CMD_UNKNOWN:
	default:
		LOG_WRN("malformed/unrecognized line ignored: \"%s\"", line);
		break;
	}
}

static void comms_rx_thread(void *p1, void *p2, void *p3)
{
	ARG_UNUSED(p1);
	ARG_UNUSED(p2);
	ARG_UNUSED(p3);

	/* Wait for comms_tx's thread to have bound the shared UART device,
	 * regardless of which of the two auto-started threads runs first.
	 */
	comms_transport_wait_ready();

	while (1) {
		char line[COMMS_CODEC_MAX_LINE];

		comms_transport_recv_line(line, sizeof(line));
		handle_line(line);
	}
}

K_THREAD_DEFINE(comms_rx_tid, 1280, comms_rx_thread, NULL, NULL, NULL, 7, 0, 0);
```

## src/comms_transport.c
```c
#include "comms_transport.h"
#include "comms_codec.h"

#include <zephyr/kernel.h>
#include <zephyr/device.h>
#include <zephyr/drivers/uart.h>
#include <zephyr/sys/ring_buffer.h>
#include <zephyr/logging/log.h>

#include <string.h>
#include <errno.h>

LOG_MODULE_REGISTER(comms_transport, CONFIG_LOG_DEFAULT_LEVEL);

/*
 * The protocol link is the board's existing console UART (USART1, wired up
 * in boards/demo/demo.dts as zephyr,console). We deliberately do NOT go
 * through the console/logging subsystem for it -- see
 * specs/communication.spec.md and docs/task-distribution.md's "serial
 * protocol vs logging" decision. Logging is on RTT instead (prj.conf).
 */
#define COMMS_UART_NODE DT_CHOSEN(zephyr_console)

static const struct device *comms_uart_dev;

/* One-shot readiness latch: gives once comms_transport_init() has run, so
 * comms_rx's thread can wait on it regardless of whether comms_tx's or
 * comms_rx's auto-started thread happens to run first.
 */
K_SEM_DEFINE(comms_transport_ready_sem, 0, 1);

RING_BUF_DECLARE(comms_tx_ring, 256);

struct comms_rx_line {
	char line[COMMS_CODEC_MAX_LINE];
};

K_MSGQ_DEFINE(comms_rx_line_q, sizeof(struct comms_rx_line), 8, 4);

/* Only ever touched from the UART ISR (single producer), so no locking
 * needed for the assembly buffer itself.
 */
static char comms_rx_assembly[COMMS_CODEC_MAX_LINE];
static size_t comms_rx_assembly_len;

static void comms_rx_assembly_push_line(void)
{
	struct comms_rx_line msg;

	comms_rx_assembly[comms_rx_assembly_len] = '\0';
	memcpy(msg.line, comms_rx_assembly, comms_rx_assembly_len + 1);
	comms_rx_assembly_len = 0;

	if (k_msgq_put(&comms_rx_line_q, &msg, K_NO_WAIT) != 0) {
		/* RX thread fell behind: drop the oldest queued line rather
		 * than blocking the ISR or losing the newest one silently.
		 */
		struct comms_rx_line discard;

		(void)k_msgq_get(&comms_rx_line_q, &discard, K_NO_WAIT);
		(void)k_msgq_put(&comms_rx_line_q, &msg, K_NO_WAIT);
	}
}

static void comms_uart_isr(const struct device *dev, void *user_data)
{
	ARG_UNUSED(user_data);

	while (uart_irq_update(dev) && uart_irq_is_pending(dev)) {
		if (uart_irq_tx_ready(dev)) {
			uint8_t byte;

			if (ring_buf_get(&comms_tx_ring, &byte, 1) == 1) {
				uart_fifo_fill(dev, &byte, 1);
			} else {
				uart_irq_tx_disable(dev);
			}
		}

		if (uart_irq_rx_ready(dev)) {
			uint8_t byte;

			while (uart_fifo_read(dev, &byte, 1) == 1) {
				if (byte == '\n') {
					comms_rx_assembly_push_line();
				} else if (byte != '\r') {
					if (comms_rx_assembly_len <
					    sizeof(comms_rx_assembly) - 1) {
						comms_rx_assembly[comms_rx_assembly_len++] =
							(char)byte;
					} else {
						/* Line too long: resync on the next
						 * '\n' instead of overflowing or
						 * ever crashing.
						 */
						comms_rx_assembly_len = 0;
					}
				}
			}
		}
	}
}

int comms_transport_init(void)
{
	comms_uart_dev = DEVICE_DT_GET(COMMS_UART_NODE);

	if (!device_is_ready(comms_uart_dev)) {
		LOG_ERR("comms UART device not ready");
		/* Still latch "ready" so comms_rx doesn't block forever on a
		 * dead link -- its calls into a not-ready device will just be
		 * no-ops/errors from here on, logged via RTT, never a hang.
		 */
		k_sem_give(&comms_transport_ready_sem);
		return -ENODEV;
	}

	uart_irq_callback_user_data_set(comms_uart_dev, comms_uart_isr, NULL);
	uart_irq_rx_enable(comms_uart_dev);

	k_sem_give(&comms_transport_ready_sem);
	return 0;
}

void comms_transport_wait_ready(void)
{
	/* Take-then-give: this is a one-shot "has init happened yet" latch,
	 * not a mutex, so every waiter (there's only ever one -- comms_rx)
	 * must see it stay signaled forever after the first give.
	 */
	k_sem_take(&comms_transport_ready_sem, K_FOREVER);
	k_sem_give(&comms_transport_ready_sem);
}

void comms_transport_send_line(const char *line)
{
	size_t len = strlen(line);
	uint32_t put = ring_buf_put(&comms_tx_ring, (const uint8_t *)line, len);
	const uint8_t nl = '\n';

	if (put == len) {
		put += ring_buf_put(&comms_tx_ring, &nl, 1);
	}

	if (put != len + 1) {
		LOG_WRN("TX ring full, dropped line (wanted %u bytes, wrote %u)",
			(unsigned int)(len + 1), (unsigned int)put);
	}

	uart_irq_tx_enable(comms_uart_dev);
}

void comms_transport_recv_line(char *buf, size_t buf_len)
{
	struct comms_rx_line msg;

	k_msgq_get(&comms_rx_line_q, &msg, K_FOREVER);

	size_t n = strlen(msg.line);

	if (n >= buf_len) {
		n = buf_len - 1;
	}
	memcpy(buf, msg.line, n);
	buf[n] = '\0';
}
```
