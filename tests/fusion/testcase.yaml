## tests/fusion/testcase.yaml
```yaml
tests:
  fusion.gesture_recognition:
    platform_allow:
      - native_sim
      - native_sim/native/64
    integration_platforms:
      - native_sim
    tags:
      - fusion
```
